## drivers/net/wireless/mt66xx/Kconfig
```kconfig
menu "MediaTek WLAN Config"

config MTK_COMBO_WIFI
	tristate "MediaTek Combo Chip Wi-Fi support"
	depends on MTK_COMBO
	depends on MMC
	depends on IPV6
	depends on !mt592x
	select WIRELESS_EXT
	select WEXT_PRIV
	select MTK_WLAN_SUPPORT
	help
	  This module adds support for wireless adapters based on
	  MTK MT6620 chipset.

	  This driver uses the kernel's wireless extensions subsystem.

	  If you choose to build a module, it'll be called dhd. Say M if
	  unsure.

config MTK_WLAN_CHIP
	string "MTK_WLAN_CHIP"
	default "MT6620" if MTK_COMBO_CHIP_MT6620
	default "MT6628" if MTK_COMBO_CHIP_MT6628
	default "MT6630" if MTK_COMBO_CHIP_MT6630
	help
	  Define the wlan chip, the MTK_WLAN_SUPPORT must be set yes
config MTK_WLAN_SUPPORT
	bool "MTK_WLAN_SUPPORT"
	help
	  The Wlan switch for the wlan feature in the Android(app,
	  framework, native, kernel).

config MTK_WAPI_SUPPORT
	bool "MTK_WAPI_SUPPORT"
	depends on MTK_WLAN_SUPPORT
	help
	   if it is set to TRUE: Support WAPI (WLAN Authentication and
	   Privacy Infrastructure) if it is set to FALSE: Does not Support
	   WAPI (WLAN Authentication and Privacy Infrastructure)

config MTK_PASSPOINT_R1_SUPPORT
	bool "MTK_PASSPOINT_R1_SUPPORT"
	help
	  Support Passpoint R1 (Hotspot 2.0 R1)

config MTK_PASSPOINT_R2_SUPPORT
	bool "MTK_PASSPOINT_R2_SUPPORT"
	help
	   Support Passpoint R2

config MTK_COMBO_WIFI
	tristate "MediaTek combo chip Wi-Fi support"
	depends on MTK_COMBO
	depends on !mt592x
	select WIRELESS_EXT
	select WEXT_PRIV

config MTK_DHCPV6C_WIFI
	bool "MTK_DHCPV6C_WIFI"
	help
	  no: disable this feature

config MTK_WIFI_MCC_SUPPORT
	bool "MTK_WIFI_MCC_SUPPORT"
	default y
	help
	   if it is set to TRUE, wlan will support Multi-Channel Concurrency,
	   otherwise, only support Single Channel Concurrency

config MTK_WFD_SUPPORT
	bool "MTK_WFD_SUPPORT"
	help
	  Wi-Fi Display Switch
endmenu
```
